## drivers/usb/musb/Kconfig
```kconfig
#
# USB Dual Role (OTG-ready) Controller Drivers
# for silicon based on Mentor Graphics INVENTRA designs
#

# (M)HDRC = (Multipoint) Highspeed Dual-Role Controller
config USB_MUSB_HDRC
	tristate 'Inventra Highspeed Dual Role Controller (TI, ADI, ...)'
	depends on USB && USB_GADGET
	select NOP_USB_XCEIV if (ARCH_DAVINCI || MACH_OMAP3EVM || BLACKFIN)
	select NOP_USB_XCEIV if (SOC_OMAPTI81XX || SOC_OMAPAM33XX)
	select TWL4030_USB if MACH_OMAP_3430SDP
	select TWL6030_USB if MACH_OMAP_4430SDP || MACH_OMAP4_PANDA
	select USB_OTG_UTILS
	select USB_GADGET_DUALSPEED
	help
	  Say Y here if your system has a dual role high speed USB
	  controller based on the Mentor Graphics silicon IP.  Then
	  configure options to match your silicon and the board
	  it's being used with, including the USB peripheral role,
	  or the USB host role, or both.

	  Texas Instruments familiies using this IP include DaVinci
	  (35x, 644x ...), OMAP 243x, OMAP 3, and TUSB 6010.

	  Analog Devices parts using this IP include Blackfin BF54x,
	  BF525 and BF527.

	  If you do not know what this is, please say N.

	  To compile this driver as a module, choose M here; the
	  module will be called "musb-hdrc".

if USB_MUSB_HDRC

comment "Platform Glue Layer"

config USB_MUSB_DAVINCI_GLUE
	select USB_MUSB_DAVINCI
	tristate "DaVinci"
	depends on ARCH_DAVINCI_DMx && USB_MUSB_HDRC

config USB_MUSB_DA8XX_GLUE
	select USB_MUSB_DA8XX
	tristate "DA8xx/OMAP-L1x"
	depends on ARCH_DAVINCI_DA8XX && USB_MUSB_HDRC

config USB_MUSB_TUSB6010_GLUE
	select USB_MUSB_TUSB6010
	tristate "TUSB6010"
	depends on ARCH_OMAP && USB_MUSB_HDRC

config USB_MUSB_OMAP2PLUS_GLUE
	select USB_MUSB_OMAP2PLUS
	tristate "OMAP2430 and onwards"
	depends on ARCH_OMAP2PLUS && USB_MUSB_HDRC

config USB_MUSB_AM35X_GLUE
	select USB_MUSB_AM35X
	tristate "AM35x"
	depends on ARCH_OMAP && USB_MUSB_HDRC

config USB_MUSB_TI81XX_GLUE
	select USB_MUSB_TI81XX
	tristate "TI81XX onward"
	depends on (SOC_OMAPTI81XX || SOC_OMAPAM33XX) && USB_MUSB_HDRC

config USB_MUSB_BLACKFIN_GLUE
	select USB_MUSB_BLACKFIN
	tristate "Blackfin"
	depends on (BF54x && !BF544) || (BF52x && ! BF522 && !BF523) && USB_MUSB_HDRC

config USB_MUSB_UX500_GLUE
	select USB_MUSB_UX500
	tristate "U8500 and U5500"
	depends on (ARCH_U8500 && AB8500_USB) && USB_MUSB_HDRC

config USB_MUSB_DAVINCI
	bool
	default n
config USB_MUSB_DA8XX
	bool
	default n
config USB_MUSB_TUSB6010
	bool
	default n
config USB_MUSB_OMAP2PLUS
	bool
	default n
config USB_MUSB_AM35X
	bool
	default n
config USB_MUSB_TI81XX
	bool
	default n
config USB_MUSB_BLACKFIN
	bool
	default n
config USB_MUSB_UX500
	bool
	default n


choice
	prompt "TI81XX usb connector's ID pin control"
	depends on SOC_OMAPTI81XX
	depends on USB_MUSB_HDRC && USB_MUSB_TI81XX_GLUE
	help
	  Dual-Role devices can support both host and peripheral roles,
	  as well as a the special "OTG Device" role which can switch
	  between both roles as needed. For this the ID pin can be
	  controlled either by software or by external usb connectors
	  ID pin (mini-A cable has ID pin grounded and mini-B side of
	  cable the ID pin is open)

config USB_TI81XX_USBID_CTRL_SW
	depends on USB_MUSB_HDRC
	bool "from software setting"
	help
	  Say Y here if your system supports the dual role configuration
	  based on the external usb connectors ID pin. The host role and
	  device role can be controlled by setting ID pin value (ground or
	  open) through software.

config USB_TI81XX_USBID_CTRL_HW
	depends on USB_MUSB_HDRC
	bool "from usb connector"
	help
	  Say Y here if your system supports the dual role configuration
	  based on the external usb connectors ID pin. For host role
	  use mini-A/micro-A usb cable (ID pin grounded) and for device
	  role use mini-B/micro-B usb cable. The USB-ID pin controlled
	  through external ID pin based on usb cable connected.
endchoice

choice
	prompt "Force TI81XX USB0 to "
	depends on USB_MUSB_HDRC && USB_MUSB_OTG && USB_TI81XX_USBID_CTRL_SW
	help
	  The usb0 controller can be configured to host role or
	  device role. The USB ID pin configuration is done
	  through software control. For host role the USB ID pin is grounded
	  and for device role the USB ID pin is open.

config USB_MUSB0_HOST
	depends on USB_MUSB_HDRC
	bool "Host mode"
	help
	  Select this configuration to configure the usb0 for
	  host role. The USB ID pin is configuration through
	  software control. For host role the USB ID pin is grounded
	  and for device role the USB ID pin is open.

config USB_MUSB0_DEVICE
	depends on USB_MUSB_HDRC
	bool "Device mode"
	help
	  Select this configuration to configure the usb0 for
	  device role. The USB ID pin is configuration through
	  software control. For host role the USB ID pin is grounded
	  and for device role the USB ID pin is open.

endchoice

choice
	prompt "Force TI81XX USB1 to "
	depends on USB_MUSB_HDRC && USB_MUSB_OTG && USB_TI81XX_USBID_CTRL_SW
	help
	  The usb1 controller can be configured to host role or
	  device role. The USB ID pin configuration is done
	  through software control. For host role the USB ID pin is grounded
	  and for device role the USB ID pin is open.

config USB_MUSB1_HOST
	depends on USB_MUSB_HDRC
	bool "Host mode"
	help
	  Select this configuration to configure the usb1 for
	  host role. The USB ID pin is configuration through
	  software control. For host role the USB ID pin is grounded
	  and for device role the USB ID pin is open.

config USB_MUSB1_DEVICE
	depends on USB_MUSB_HDRC
	bool "Device mode"
	help
	  Select this configuration to configure the usb1 for
	  device role. The USB ID pin is configuration through
	  software control. For host role the USB ID pin is grounded
	  and for device role the USB ID pin is open.

endchoice

choice
	prompt 'MUSB DMA mode'
	depends on !MUSB_PIO_ONLY
	default USB_UX500_DMA_HW if USB_MUSB_UX500
	default USB_INVENTRA_DMA_HW if USB_MUSB_OMAP2PLUS || USB_MUSB_BLACKFIN
	default USB_TI_CPPI_DMA_HW if USB_MUSB_DAVINCI
	default USB_TUSB_OMAP_DMA_HW if USB_MUSB_TUSB6010
	default USB_TI_CPPI41_DMA_HW if USB_MUSB_DA8XX || USB_MUSB_AM35X || USB_MUSB_TI81XX
	help
	  Unfortunately, only one option can be enabled here. Ideally one
	  should be able to build all these drivers into one kernel to
	  allow using DMA on multiplatform kernels.

config USB_UX500_DMA_HW
	tristate 'ST Ericsson U8500 and U5500'
	select USB_UX500_DMA
	depends on USB_MUSB_UX500
	help
	  Enable DMA transfers on UX500 platforms.

config USB_INVENTRA_DMA_HW
	tristate 'Inventra'
	select USB_INVENTRA_DMA
	depends on (USB_MUSB_OMAP2PLUS || USB_MUSB_BLACKFIN) && !USB_MUSB_AM35X
	help
	  Enable DMA transfers using Mentor's engine.

config USB_TI_CPPI_DMA_HW
	tristate 'TI CPPI (Davinci)'
	select USB_TI_CPPI_DMA
	depends on USB_MUSB_DAVINCI
	help
	  Enable DMA transfers when TI CPPI DMA is available.

config USB_TI_CPPI41_DMA_HW
	tristate 'TI CPPI4.1'
	select USB_TI_CPPI41_DMA
	depends on USB_MUSB_DA8XX || USB_MUSB_AM35X || USB_MUSB_TI81XX
	select CPPI41
	help
	 Configure this option to include the CPPI 4.1 support,
	 The CPPI 4.1 DMA engine integrated with musb controller
	 accelarate the usb packet transmission and receception
	 to/from musb endpoints.

config USB_TUSB_OMAP_DMA_HW
	tristate 'TUSB 6010'
	select USB_TUSB_OMAP_DMA
	depends on USB_MUSB_TUSB6010
	depends on ARCH_OMAP
	help
	  Enable DMA transfers on TUSB 6010 when OMAP DMA is available.

endchoice

config MUSB_PIO_ONLY
	bool 'Disable DMA (always use PIO)'
	default USB_MUSB_TUSB6010 || USB_MUSB_DA8XX
	help
	  All data is copied between memory and FIFO by the CPU.
	  DMA controllers are ignored.

	  Do not choose this unless DMA support for your SOC or board
	  is unavailable (or unstable).  When DMA is enabled at compile time,
	  you can still disable it at run time using the "use_dma=n" module
	  parameter.

config USB_INVENTRA_DMA
	bool
	default n

config USB_TI_CPPI_DMA
	bool
	default n

config USB_TI_CPPI41_DMA
	bool
	default n

config USB_TUSB_OMAP_DMA
	bool
	default n

config USB_UX500_DMA
	bool
	default n

endif # USB_MUSB_HDRC
```
